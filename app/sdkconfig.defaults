## app/sdkconfig.defaults
```kconfig
# Override some defaults so BT stack is enabled
# by default in this example
CONFIG_BT_ENABLED=y
CONFIG_BT_GATTS_SEND_SERVICE_CHANGE_MANUAL=y
CONFIG_BT_BTU_TASK_STACK_SIZE=4512
CONFIG_PARTITION_TABLE_SINGLE_APP_LARGE=y

# Override some defaults of ESP BLE Mesh
CONFIG_BLE_MESH=y
CONFIG_BLE_MESH_NODE=y
CONFIG_BLE_MESH_PB_GATT=y
CONFIG_BLE_MESH_TX_SEG_MSG_COUNT=10
CONFIG_BLE_MESH_RX_SEG_MSG_COUNT=10
#
# Support for BLE Mesh Client/Server models
#
CONFIG_BLE_MESH_GENERIC_ONOFF_CLI=y
CONFIG_BLE_MESH_GENERIC_LEVEL_CLI=y
CONFIG_BLE_MESH_GENERIC_DEF_TRANS_TIME_CLI=y
CONFIG_BLE_MESH_GENERIC_POWER_ONOFF_CLI=y
CONFIG_BLE_MESH_GENERIC_POWER_LEVEL_CLI=y
CONFIG_BLE_MESH_GENERIC_BATTERY_CLI=y
CONFIG_BLE_MESH_GENERIC_LOCATION_CLI=y
CONFIG_BLE_MESH_GENERIC_PROPERTY_CLI=y
CONFIG_BLE_MESH_SENSOR_CLI=y
CONFIG_BLE_MESH_TIME_CLI=y
CONFIG_BLE_MESH_SCENE_CLI=y
CONFIG_BLE_MESH_SCHEDULER_CLI=y
CONFIG_BLE_MESH_LIGHT_LIGHTNESS_CLI=y
CONFIG_BLE_MESH_LIGHT_CTL_CLI=y
CONFIG_BLE_MESH_LIGHT_HSL_CLI=y
CONFIG_BLE_MESH_LIGHT_XYL_CLI=y
CONFIG_BLE_MESH_LIGHT_LC_CLI=y
CONFIG_BLE_MESH_GENERIC_SERVER=y
CONFIG_BLE_MESH_SENSOR_SERVER=y
CONFIG_BLE_MESH_TIME_SCENE_SERVER=y
CONFIG_BLE_MESH_LIGHTING_SERVER=y

# MeshX NVS default enable
CONFIG_BLE_MESH_SETTINGS=y
CONFIG_BLE_MESH_STORE_TIMEOUT=1
CONFIG_BLE_MESH_SEQ_STORE_RATE=0
CONFIG_BLE_MESH_RPL_STORE_TIMEOUT=2

# FreeRTOS related
CONFIG_FREERTOS_USE_TRACE_FACILITY=y

# CONFIG_BLE_MESH_SPECIFIC_PARTITION=y
# CONFIG_BLE_MESH_PARTITION_NAME="MESHX_NVS"
```

## port/platform/esp/esp32/sdkconfig.defaults.esp32
```kconfig
# Override some defaults so BT stack is enabled
# by default in this example
CONFIG_IDF_TARGET="esp32"
```

## port/platform/esp/esp_idf/sdkconfig.defaults.ble_mesh
```kconfig
CONFIG_SOC_BLE_MESH_SUPPORTED=y
CONFIG_BTDM_BLE_MESH_SCAN_DUPL_EN=y
CONFIG_BLE_MESH=y
CONFIG_BLE_MESH_HCI_5_0=y
CONFIG_BLE_MESH_V11_SUPPORT=y
# CONFIG_BLE_MESH_RANDOM_ADV_INTERVAL is not set
CONFIG_BLE_MESH_USE_DUPLICATE_SCAN=y
# CONFIG_BLE_MESH_ACTIVE_SCAN is not set
CONFIG_BLE_MESH_MEM_ALLOC_MODE_INTERNAL=y
# CONFIG_BLE_MESH_MEM_ALLOC_MODE_DEFAULT is not set
CONFIG_BLE_MESH_DEINIT=y
# CONFIG_BLE_MESH_SUPPORT_BLE_ADV is not set
# CONFIG_BLE_MESH_SUPPORT_BLE_SCAN is not set
# CONFIG_BLE_MESH_FAST_PROV is not set
CONFIG_BLE_MESH_NODE=y
# CONFIG_BLE_MESH_PROVISIONER is not set
CONFIG_BLE_MESH_PROV=y
CONFIG_BLE_MESH_PROV_EPA=y
# CONFIG_BLE_MESH_CERT_BASED_PROV is not set
CONFIG_BLE_MESH_PB_ADV=y
CONFIG_BLE_MESH_UNPROVISIONED_BEACON_INTERVAL=5
CONFIG_BLE_MESH_PB_GATT=y
CONFIG_BLE_MESH_PROXY=y
CONFIG_BLE_MESH_GATT_PROXY_SERVER=y
CONFIG_BLE_MESH_NODE_ID_TIMEOUT=60
CONFIG_BLE_MESH_PROXY_FILTER_SIZE=4
# CONFIG_BLE_MESH_PROXY_SOLIC_PDU_RX is not set
# CONFIG_BLE_MESH_GATT_PROXY_CLIENT is not set
CONFIG_BLE_MESH_NET_BUF_POOL_USAGE=y
CONFIG_BLE_MESH_SETTINGS=y
CONFIG_BLE_MESH_STORE_TIMEOUT=1
CONFIG_BLE_MESH_SEQ_STORE_RATE=0
CONFIG_BLE_MESH_RPL_STORE_TIMEOUT=2
# CONFIG_BLE_MESH_SETTINGS_BACKWARD_COMPATIBILITY is not set
# CONFIG_BLE_MESH_SPECIFIC_PARTITION is not set
CONFIG_BLE_MESH_SUBNET_COUNT=3
CONFIG_BLE_MESH_APP_KEY_COUNT=3
CONFIG_BLE_MESH_MODEL_KEY_COUNT=3
CONFIG_BLE_MESH_MODEL_GROUP_COUNT=3
CONFIG_BLE_MESH_LABEL_COUNT=3
CONFIG_BLE_MESH_CRPL=10
CONFIG_BLE_MESH_MSG_CACHE_SIZE=10
CONFIG_BLE_MESH_ADV_BUF_COUNT=60
CONFIG_BLE_MESH_IVU_DIVIDER=4
# CONFIG_BLE_MESH_IVU_RECOVERY_IVI is not set
# CONFIG_BLE_MESH_SAR_ENHANCEMENT is not set
CONFIG_BLE_MESH_TX_SEG_MSG_COUNT=10
CONFIG_BLE_MESH_RX_SEG_MSG_COUNT=10
CONFIG_BLE_MESH_RX_SDU_MAX=384
CONFIG_BLE_MESH_TX_SEG_MAX=32
CONFIG_BLE_MESH_RELAY=y
# CONFIG_BLE_MESH_RELAY_ADV_BUF is not set
# CONFIG_BLE_MESH_LOW_POWER is not set
# CONFIG_BLE_MESH_FRIEND is not set
# CONFIG_BLE_MESH_NO_LOG is not set
# CONFIG_BLE_MESH_TRACE_LEVEL_NONE is not set
# CONFIG_BLE_MESH_TRACE_LEVEL_ERROR is not set
CONFIG_BLE_MESH_TRACE_LEVEL_WARNING=y
# CONFIG_BLE_MESH_TRACE_LEVEL_INFO is not set
# CONFIG_BLE_MESH_TRACE_LEVEL_DEBUG is not set
# CONFIG_BLE_MESH_TRACE_LEVEL_VERBOSE is not set
CONFIG_BLE_MESH_STACK_TRACE_LEVEL=2
# CONFIG_BLE_MESH_NET_BUF_TRACE_LEVEL_NONE is not set
# CONFIG_BLE_MESH_NET_BUF_TRACE_LEVEL_ERROR is not set
CONFIG_BLE_MESH_NET_BUF_TRACE_LEVEL_WARNING=y
# CONFIG_BLE_MESH_NET_BUF_TRACE_LEVEL_INFO is not set
# CONFIG_BLE_MESH_NET_BUF_TRACE_LEVEL_DEBUG is not set
# CONFIG_BLE_MESH_NET_BUF_TRACE_LEVEL_VERBOSE is not set
CONFIG_BLE_MESH_NET_BUF_TRACE_LEVEL=2
CONFIG_BLE_MESH_CLIENT_MSG_TIMEOUT=4000
# CONFIG_BLE_MESH_CFG_CLI is not set
# CONFIG_BLE_MESH_HEALTH_CLI is not set
CONFIG_BLE_MESH_HEALTH_SRV=y
# CONFIG_BLE_MESH_BRC_CLI is not set
# CONFIG_BLE_MESH_BRC_SRV is not set
# CONFIG_BLE_MESH_PRB_CLI is not set
# CONFIG_BLE_MESH_PRB_SRV is not set
# CONFIG_BLE_MESH_ODP_CLI is not set
# CONFIG_BLE_MESH_SRPL_CLI is not set
# CONFIG_BLE_MESH_AGG_CLI is not set
# CONFIG_BLE_MESH_AGG_SRV is not set
# CONFIG_BLE_MESH_SAR_CLI is not set
# CONFIG_BLE_MESH_SAR_SRV is not set
# CONFIG_BLE_MESH_COMP_DATA_1 is not set
# CONFIG_BLE_MESH_COMP_DATA_128 is not set
# CONFIG_BLE_MESH_MODELS_METADATA_0 is not set
# CONFIG_BLE_MESH_LCD_CLI is not set
# CONFIG_BLE_MESH_LCD_SRV is not set
# CONFIG_BLE_MESH_RPR_SRV is not set
# CONFIG_BLE_MESH_DF_CLI is not set
# CONFIG_BLE_MESH_DF_SRV is not set
CONFIG_BLE_MESH_GENERIC_ONOFF_CLI=y
CONFIG_BLE_MESH_GENERIC_LEVEL_CLI=y
CONFIG_BLE_MESH_GENERIC_DEF_TRANS_TIME_CLI=y
CONFIG_BLE_MESH_GENERIC_POWER_ONOFF_CLI=y
CONFIG_BLE_MESH_GENERIC_POWER_LEVEL_CLI=y
CONFIG_BLE_MESH_GENERIC_BATTERY_CLI=y
CONFIG_BLE_MESH_GENERIC_LOCATION_CLI=y
CONFIG_BLE_MESH_GENERIC_PROPERTY_CLI=y
CONFIG_BLE_MESH_SENSOR_CLI=y
CONFIG_BLE_MESH_TIME_CLI=y
CONFIG_BLE_MESH_SCENE_CLI=y
CONFIG_BLE_MESH_SCHEDULER_CLI=y
CONFIG_BLE_MESH_LIGHT_LIGHTNESS_CLI=y
CONFIG_BLE_MESH_LIGHT_CTL_CLI=y
CONFIG_BLE_MESH_LIGHT_HSL_CLI=y
CONFIG_BLE_MESH_LIGHT_XYL_CLI=y
CONFIG_BLE_MESH_LIGHT_LC_CLI=y
CONFIG_BLE_MESH_GENERIC_SERVER=y
CONFIG_BLE_MESH_SENSOR_SERVER=y
CONFIG_BLE_MESH_TIME_SCENE_SERVER=y
CONFIG_BLE_MESH_LIGHTING_SERVER=y
# CONFIG_BLE_MESH_MBT_CLI is not set
# CONFIG_BLE_MESH_MBT_SRV is not set
# CONFIG_BLE_MESH_IV_UPDATE_TEST is not set
CONFIG_BLE_MESH_DISCARD_OLD_SEQ_AUTH=y
# CONFIG_BLE_MESH_SELF_TEST is not set
# CONFIG_BLE_MESH_BQB_TEST is not set
# CONFIG_BLE_MESH_SHELL is not set
# CONFIG_BLE_MESH_DEBUG is not set
# CONFIG_BLE_MESH_EXPERIMENTAL is not set
```
